## CMakeLists.txt
```
cmake_minimum_required(VERSION 3.20.0)

find_package(Zephyr REQUIRED HINTS $ENV{ZEPHYR_BASE})
project(sample_test_suite)

FILE(GLOB test_script src/*.c)
FILE(GLOB test_source ../../src/*.c)
list(FILTER test_source EXCLUDE REGEX "main.c$")


target_sources(app PRIVATE ${test_script})
target_sources(app PRIVATE ${test_source})

target_include_directories(app PRIVATE ${CMAKE_CURRENT_SOURCE_DIR}/../../include)
zephyr_library_include_directories(D:/ncs/v2.1.2/zephyr/subsys/testsuite/ztest/include/zephyr)
```

## prj.conf
```kconfig
CONFIG_ZTEST=y
CONFIG_ZTEST_NEW_API=n
CONFIG_ZTEST_MOCKING=y
CONFIG_MAIN_STACK_SIZE=4096

#from source code
CONFIG_GPIO=y
CONFIG_SPI=y

CONFIG_SPI_ASYNC=y

CONFIG_SERIAL=y
CONFIG_UART_INTERRUPT_DRIVEN=y

CONFIG_SENSOR=y

CONFIG_NEWLIB_LIBC=y # Make sure to remove after debug to reduce image size?
CONFIG_NEWLIB_LIBC_FLOAT_PRINTF=y # Make sure to remove after debug to reduce image size?
```

## nrf52dk_nrf52832.overlay
```dts
// To get started, press Ctrl+Space to bring up the completion menu and view the available nodes.

// You can also use the buttons in the sidebar to perform actions on nodes.
// Actions currently available include:

// * Enabling / disabling the node
// * Adding the bus to a bus
// * Removing the node
// * Connecting ADC channels

// For more help, browse the DeviceTree documentation at https: //docs.zephyrproject.org/latest/guides/dts/index.html
// You can also visit the nRF DeviceTree extension documentation at https: //nrfconnect.github.io/vscode-nrf-connect/devicetree/nrfdevicetree.html

&gpio0 {
	status = "okay";
};

&spi1 {
	status = "okay";
	cs-gpios = <&gpio0 28 GPIO_ACTIVE_LOW>,
				<&gpio0 4 GPIO_ACTIVE_LOW>;

};

&uart0 {
	current-speed = < 115200 >;
};
```

## src/main.c
```c
#include <ztest.h>
#include <zephyr/kernel.h>
#include <zephyr/drivers/spi.h>
#include <zephyr/drivers/gpio.h>
// #include <ztest_test_deprecated.h>
#include "max30003.h"
#include "lsm6dsm.h"
#include "spi_config.h"
#include "utils.h"

char accel[16] = "lsm6dsm_test";
char ecg[16] = "max30003_test";

#define WRITE_BIT_SET(reg) (reg & ~(1 << 7))
#define READ_BIT_SET(reg) (reg | (1 << 7))

extern uint8_t buffer_tx[BUF_SIZE];
extern uint8_t buffer_rx[BUF_SIZE];
extern uint8_t buffer_print_tx[BUF_SIZE * 5 + 1];
extern uint8_t buffer_print_rx[BUF_SIZE * 5 + 1];
extern struct spi_buf tx_bufs[1];
extern struct spi_buf rx_bufs[1];
// extern const struct spi_buf_set tx;
// extern const struct spi_buf_set rx;

static void test_lsm6dsm_read_buffer(void)
{
    uint8_t data;

    int lsm6dsm_r_ret = lsm6dsm_read_buffer(0x0F, &data);
    zassert_equal(0, lsm6dsm_r_ret, "lsm6dsm function call failed");

    to_display_format(buffer_rx, BUF_SIZE, buffer_print_rx);
    to_display_format(buffer_tx, BUF_SIZE, buffer_print_tx);
    // zassert_equal(0,data,"data is %x",data);
    zassert_equal(0x6A, buffer_rx[1], "Buffer content mismatch, TX Buffer:  %s\n RX Buffer:  %s\n ", buffer_print_tx, buffer_print_rx);
}

static void test_max30003_read(void)
{
    uint8_t data[3];
    int max30003_r_ret = max30003_read(INFO, data, sizeof data);
    uint8_t data_shift = data[0] & 0xF0;
    zassert_equal(0, max30003_r_ret, "max30003 function call failed");

    to_display_format(buffer_rx, BUF_SIZE, buffer_print_rx);
    to_display_format(buffer_tx, BUF_SIZE, buffer_print_tx);
    zassert_equal(0x50, data_shift, "Buffer content mismatch, TX Buffer:  %s\n RX Buffer:  %s\n ", buffer_print_tx, buffer_print_rx);
}

// define the test suite and test cases
void test_main(void)
{
    ztest_test_suite(ECG_test_suite,
                     ztest_unit_test(test_lsm6dsm_read_buffer), ztest_unit_test(test_max30003_read));

    // run the test suite
    ztest_run_test_suite(ECG_test_suite);
}
```
