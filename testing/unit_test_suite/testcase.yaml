## testing/unit_test_suite/testcase.yaml
```yaml
tests:
  # section.subsection
  sample.testing.ztest:
    build_only: false
    platform_allow: nrf52dk_nrf52832
    integration_platforms:
      - nrf52dk_nrf52832
    tags: testing
 
    

  
```
